## firmware/application_idf/main/Kconfig.projbuild
```kconfig
menu "Pen application candidate - no camera provider supplied"
config PEN_APP_RUN_APPROVED_PROVIDER
    bool "Run separately reviewed board provider and persistence actor"
    default n
    depends on PEN_FLASH_RECORDING
    help
        Not a qualification switch. A real provider must supply verified board
        identity, sensor capture, timestamp ordering, pose calibration and link
        security. This repository supplies none. Without a provider, no GPIO,
        sensor, radio, Flash/NVS or OTA writes are attempted by app_main.
config PEN_APP_FLASH8_PROFILE
    bool "Use exact reviewed 8 MiB candidate partition contract"
    default n
    depends on IDF_TARGET_ESP32S3
    help
        Explicit profiles/flash8.csv only. Runtime checks actual physical and
        logical capacity, exact partitions, and running OTA slot.
        Does not qualify any hardware provider or authorize programming.
endmenu
```

## firmware/application_idf/sdkconfig.defaults
```kconfig
CONFIG_IDF_TARGET="esp32s3"
CONFIG_COMPILER_OPTIMIZATION_PERF=y
CONFIG_ESP_MAIN_TASK_STACK_SIZE=8192
# CONFIG_PEN_FLASH_RECORDING is not set
# CONFIG_PEN_APP_RUN_APPROVED_PROVIDER is not set
```

## firmware/bench_idf/main/Kconfig.projbuild
```kconfig
menu "SYNTHETIC BENCH ONLY - not camera firmware"
config PEN_SYNTHETIC_BENCH
    bool "Explicitly enable synthetic BLE bench data"
    default n
    help
        Never deploy as real handwriting firmware. VALID and CONTACT stay clear.
config PEN_APPROVED_PEER
    string "Approved central identity address (AA:BB:CC:DD:EE:FF)"
    default ""
    help
        Empty or invalid disables transmission and ACK. Provision manually using
        a trusted console; OTA random addresses are not stable identities.
config PEN_APPROVED_PEER_TYPE
    int "Approved identity address type: 0 public, 1 random static"
    range 0 1
    default 0
endmenu
```

## firmware/bench_idf/sdkconfig.defaults
```kconfig
CONFIG_BT_ENABLED=y
CONFIG_BT_NIMBLE_ENABLED=y
CONFIG_BT_BLUEDROID_ENABLED=n
CONFIG_BT_NIMBLE_MAX_CONNECTIONS=1
CONFIG_BT_NIMBLE_NVS_PERSIST=y
CONFIG_BT_NIMBLE_SECURITY_ENABLE=y
CONFIG_BT_NIMBLE_SM_LEGACY=y
CONFIG_BT_NIMBLE_SM_SC=y
CONFIG_ESP_MAIN_TASK_STACK_SIZE=4096
```

## firmware/runtime_idf/sdkconfig.defaults
```kconfig
CONFIG_IDF_TARGET="esp32s3"
# CONFIG_PEN_FLASH_RECORDING is not set
# CONFIG_PEN_OTA_ALLOW_INSTALL is not set
```

## firmware/storage/Kconfig
```kconfig
menu "Pen persistent recording - disabled until storage layout approved"
config PEN_FLASH_RECORDING
    bool "Enable explicit pen_records partition adapter (no automatic formatting)"
    default n
    help
        Requires approved non-encrypted raw data partition pen_records. Writes
        and erase-intent recovery occur only after explicit runtime opt-in.
        This is not approval to flash hardware or provision production keys.
endmenu
```

## firmware/update/Kconfig
```kconfig
menu "Pen controlled update adapter"
config PEN_OTA_ALLOW_INSTALL
    bool "Allow authenticated signed image installation (requires integration review)"
    default n
    help
        Default off. Runtime also requires signed OTA validation and rollback.
        Does not enable secure boot, provision keys, burn eFuses or expose a server.
config PEN_OTA_PROJECT
    string "Signed image project name (must uniquely bind hardware revision)"
    default "smartpen-unqualified"
config PEN_OTA_HARDWARE
    string "Hardware profile: must exactly equal signed project identifier"
    default "UNQUALIFIED"
endmenu
```

## verification/accepted_successors_stage_20261029/smart_pen_camera_capture_v2_candidate_20261029/idf/main/Kconfig.projbuild
```kconfig
menu "Smart pen camera compile fixture"
config PEN_CAMERA_CAPTURE_COMPILE_ENABLE
 bool "Compile enabled camera entry (NOT run authorization)"
 default n
endmenu
```

## verification/accepted_successors_stage_20261029/smart_pen_camera_capture_v2_candidate_20261029/idf/sdkconfig.defaults
```kconfig
CONFIG_IDF_TARGET="esp32s3"
CONFIG_ESPTOOLPY_FLASHSIZE_8MB=y
CONFIG_CAMERA_TASK_STACK_SIZE=4096
CONFIG_CAMERA_DMA_BUFFER_SIZE_MAX=32768
CONFIG_CAMERA_PSRAM_DMA=n
CONFIG_CAMERA_CONVERTER_ENABLED=n
CONFIG_SPIRAM=n
CONFIG_SC031GS_SUPPORT=y
CONFIG_FREERTOS_HZ=1000
CONFIG_OV7670_SUPPORT=n
CONFIG_OV7725_SUPPORT=n
CONFIG_NT99141_SUPPORT=n
CONFIG_OV2640_SUPPORT=n
CONFIG_OV3660_SUPPORT=n
CONFIG_OV3640_SUPPORT=n
CONFIG_OV5640_SUPPORT=n
CONFIG_GC2145_SUPPORT=n
CONFIG_GC032A_SUPPORT=n
CONFIG_GC0308_SUPPORT=n
CONFIG_BF3005_SUPPORT=n
CONFIG_BF20A6_SUPPORT=n
CONFIG_SC101IOT_SUPPORT=n
CONFIG_SC030IOT_SUPPORT=n
CONFIG_HM1055_SUPPORT=n
CONFIG_HM0360_SUPPORT=n
CONFIG_MEGA_CCM_SUPPORT=n
CONFIG_PEN_CAMERA_CAPTURE_COMPILE_ENABLE=n
```

## verification/ble_pc_and_mode_stage_20261029/smart_pen_ble_transport_candidate_20261029/idf/main/Kconfig.projbuild
```kconfig
menu "Smart pen BLE candidate - compile only entrypoint"
config PEN_BLE_TRANSPORT
    bool "Compile real NimBLE transport implementation"
    default n
    depends on BT_NIMBLE_ENABLED
config PEN_BLE_DEV_PAIRING
    bool "Compile development local USB-display pairing policy (not headless production)"
    default n
    depends on PEN_BLE_TRANSPORT
    help
        Does not start radio. Runtime needs explicit local consent and a reviewed
        USB display callback; a connected peer requires per-epoch local approval.
        app_main is a compile fixture, remains inert in all configurations.
endmenu
```

## verification/ble_pc_and_mode_stage_20261029/smart_pen_ble_transport_candidate_20261029/idf/sdkconfig.defaults
```kconfig
CONFIG_IDF_TARGET="esp32s3"
CONFIG_ESPTOOLPY_FLASHSIZE_2MB=y
# CONFIG_PEN_BLE_TRANSPORT is not set
# CONFIG_PEN_BLE_DEV_PAIRING is not set
```

## verification/continuous_v3_target_experiments_20261029/smart_pen_continuous_v3_target_benchmark_20261029/main/Kconfig.projbuild
```kconfig
menu "Continuous decoder cold-only benchmark"
    config PEN_DECODER_BENCH_RUN
        bool "Run fixed synthetic full-frame comparison at startup"
        default n
    config PEN_DECODER_BENCH_REPEATS
        int "Cold calls per fixture and decoder"
        depends on PEN_DECODER_BENCH_RUN
        range 1 10
        default 3
endmenu
```

## verification/decoder_experiments_20261028/smart_pen_decoder_target_benchmark_20261028/main/Kconfig.projbuild
```kconfig
menu "Standalone decoder benchmark (no board providers)"
    config PEN_DECODER_BENCH_RUN
        bool "Run synthetic pixel benchmark at startup (explicit opt-in)"
        default n
    config PEN_DECODER_BENCH_PSRAM
        bool "Also allocate benchmark pixels and workspace in initialized PSRAM"
        depends on PEN_DECODER_BENCH_RUN && SPIRAM && !APP_BUILD_TYPE_PURE_RAM_APP
        default n
    config PEN_DECODER_BENCH_REPEATS
        int "Cold/warm pairs per fixture"
        depends on PEN_DECODER_BENCH_RUN
        range 1 10
        default 3
endmenu
```

## verification/decoder_experiments_20261028/smart_pen_decoder_target_benchmark_20261028/sdkconfig.defaults
```kconfig
CONFIG_IDF_TARGET="esp32s3"
CONFIG_APP_BUILD_TYPE_RAM=y
CONFIG_APP_BUILD_TYPE_PURE_RAM_APP=y
CONFIG_APP_REPRODUCIBLE_BUILD=y
CONFIG_COMPILER_OPTIMIZATION_PERF=y
CONFIG_ESP_DEFAULT_CPU_FREQ_MHZ_240=y
CONFIG_ESP_MAIN_TASK_STACK_SIZE=16384
CONFIG_NEWLIB_NANO_FORMAT=y
CONFIG_ESP_SYSTEM_PANIC_PRINT_HALT=y
# CONFIG_ESP_TASK_WDT_EN is not set
# CONFIG_ESP_DEBUG_STUBS_ENABLE is not set
# CONFIG_ESP_ERR_TO_NAME_LOOKUP is not set
# CONFIG_VFS_SUPPORT_TERMIOS is not set
# CONFIG_PEN_DECODER_BENCH_RUN is not set
# CONFIG_PEN_DECODER_BENCH_PSRAM is not set
# CONFIG_SPIRAM is not set
# CONFIG_BT_ENABLED is not set
# CONFIG_ESP_WIFI_ENABLED is not set
```
